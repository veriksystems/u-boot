## board/skw93/Kconfig
```kconfig
if TARGET_SKW93

config SYS_BOARD
	default "skw93"

config SYS_CONFIG_NAME
	default "skw93"

endif
```

## configs/skw93_ram_defconfig
```kconfig
CONFIG_MIPS=y
CONFIG_TARGET_SKW93=y
CONFIG_SYS_EXTRA_OPTIONS="SYS_RAMBOOT,SYS_TEXT_BASE=0x80200000,SYS_MEMSIZE=64"
```

## configs/skw93lite_defconfig
```kconfig
CONFIG_MIPS=y
CONFIG_TARGET_SKW93=y
CONFIG_SYS_EXTRA_OPTIONS="SYS_TEXT_BASE=0xbc000000,SYS_MEMSIZE=64"
```
